## layers/meta-custom/conf/layer.conf
```bitbake
# We have a conf and classes directory, add to BBPATH
BBPATH .= ":${LAYERDIR}"

# We have recipes-* directories, add to BBFILES
BBFILES += "${LAYERDIR}/recipes-*/*/*.bb ${LAYERDIR}/recipes-*/*/*.bbappend"

BBFILE_COLLECTIONS += "custom"
BBFILE_PATTERN_custom = "^${LAYERDIR}/"
BBFILE_PRIORITY_custom = "5"

# This should only be incremented on significant changes that will cause compatibility issues with other layers
LAYERVERSION_custom = "1"

LAYERDEPENDS_custom = "core"

LAYERSERIES_COMPAT_custom = "kirkstone"
```
